## sdkconfig.defaults.esp32s2
```kconfig
CONFIG_IDF_TARGET="esp32s2"
CONFIG_ESP_DEFAULT_CPU_FREQ_MHZ_240=y
CONFIG_ESP_DEFAULT_CPU_FREQ_MHZ=240
CONFIG_ESP32S2_INSTRUCTION_CACHE_16KB=y
CONFIG_ESP32S2_DATA_CACHE_16KB=y
# --- Vlastné piny pre Lolin S2 Mini ---
CONFIG_BRIDGE_UART_TX_PIN=37
CONFIG_BRIDGE_UART_RX_PIN=38
CONFIG_BRIDGE_JTAG_TCK_PIN=4
CONFIG_BRIDGE_JTAG_TMS_PIN=5
CONFIG_BRIDGE_JTAG_TDI_PIN=6
CONFIG_BRIDGE_JTAG_TDO_PIN=7
CONFIG_BRIDGE_TARGET_RESET_PIN=14
CONFIG_BRIDGE_TARGET_BOOT_PIN=15
```
